## config/west.yml
```yaml
manifest:
  remotes:
    - name: zmkfirmware
      url-base: https://github.com/zmkfirmware
    - name: pite1222
      url-base: https://github.com/pite1222
    - name: caksoylar
      url-base: https://github.com/caksoylar
    - name: 4mplelab
      url-base: https://github.com/4mplelab
  projects:
    - name: zmk
      remote: zmkfirmware
      revision: edf5c0814fd3ea202e43aad2d68fd32e882a518c # ZMK v0.3
      import: app/west.yml
    # Root definitions override imported projects. Preserve Zephyr's module import.
    - name: zephyr
      remote: zmkfirmware
      revision: dacab4875df72109b96cc8977547a0dc04875bcd
      import:
        name-blocklist:
          - ci-tools
          - hal_altera
          - hal_cypress
          - hal_infineon
          - hal_microchip
          - hal_nxp
          - hal_openisa
          - hal_silabs
          - hal_xtensa
          - hal_st
          - hal_ti
          - loramac-node
          - mcuboot
          - mcumgr
          - net-tools
          - openthread
          - edtt
          - trusted-firmware-m
    - name: nanopb
      remote: zmkfirmware
      revision: 8c60555d6277a0360c876bd85d491fc4fb0cd74a
      path: modules/lib/nanopb
    - name: zmk-studio-messages
      remote: zmkfirmware
      revision: 6cb4c283e76209d59c45fbcb218800cd19e9339d
      path: modules/msgs/zmk-studio-messages
    - name: zmk-pmw3610-driver
      remote: pite1222
      revision: c05f535a51bd03ab62c6e2abc18e7a351c8e01c8
    - name: zmk-rgbled-widget
      remote: pite1222
      revision: a4f593acb74afab7f8f3ab97ee1afa816dbc8dfb
    - name: zmk-feature-charge-indicator
      remote: 4mplelab
      revision: f0d311ed7804cda0e5837ef902f0419aeace4a88
  self:
    path: config
```

## modules/nicola/dts/bindings/behaviors/zmk,behavior-ime-settle.yaml
```yaml
# SPDX-License-Identifier: GPL-2.0-or-later

description: |
  IMEキー送出直後の打鍵出力をファーム内で一定時間(param1 ms)保留し、
  ホスト側のIME切替完了を待ってから元の順序で再送出する。
  切替マクロ内でIMEキーの直後に &ime_settle <ms> として使う。

compatible: "zmk,behavior-ime-settle"

include: one_param.yaml
```

## modules/nicola/dts/bindings/behaviors/zmk,behavior-nicola-thumb.yaml
```yaml
# SPDX-License-Identifier: GPL-2.0-or-later
# Conductor拡張: 親指シフトキー専用 behavior

description: NICOLA thumb shift key (left or right)

compatible: "zmk,behavior-nicola-thumb"

include: two_param.yaml

properties:
  side:
    type: int
    required: true
    description: |
      0 = 左親指シフト、1 = 右親指シフト。
      binding の第1引数は単独タップで送出するキーコード、第2引数は単独タップで
      離脱 (deactivate) するレイヤー番号。NC_KEEP_LAYER (255) なら離脱しない。
```
